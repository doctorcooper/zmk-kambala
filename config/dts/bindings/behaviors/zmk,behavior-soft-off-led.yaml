## config/dts/bindings/behaviors/zmk,behavior-soft-off-led.yaml
```yaml
description: Soft off with an LED hold countdown
compatible: "zmk,behavior-soft-off-led"
include: zero_param.yaml

properties:
  hold-time-ms:
    type: int
    required: true
```
